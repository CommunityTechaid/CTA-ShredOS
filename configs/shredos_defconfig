## configs/shredos_defconfig
```kconfig
BR2_x86_64=y
BR2_x86_nocona=y
BR2_PACKAGE_GLIBC_UTILS=y
# BR2_TOOLCHAIN_BUILDROOT_CXX=y
# BR2_TOOLCHAIN_GLIBC_GCONV_LIBS_COPY=y
BR2_CPAN_MIRROR="http://cpan.metacpan.org"
BR2_TARGET_GENERIC_HOSTNAME="shredos"
BR2_TARGET_GENERIC_ISSUE="Welcome to ShredOS https://github.com/PartialVolume/shredos.x86_64"
BR2_INIT_SYSV=y
BR2_ROOTFS_MERGED_USR=y
BR2_SYSTEM_BIN_SH_BASH=y
BR2_SYSTEM_DEFAULT_PATH="/bin:/sbin:/usr/bin:/usr/sbin"
BR2_ENABLE_LOCALE_PURGE=y
BR2_ENABLE_LOCALE_WHITELIST="C en_GB"
BR2_GENERATE_LOCALE="en_GB.UTF-8"
BR2_SYSTEM_ENABLE_NLS=n
BR2_TARGET_TZ_INFO=y
BR2_ROOTFS_OVERLAY="board/shredos/fsoverlay"
BR2_ROOTFS_POST_IMAGE_SCRIPT="board/shredos/doimg.sh"
BR2_LINUX_KERNEL=y
BR2_LINUX_KERNEL_ZSTD=y
BR2_LINUX_KERNEL_USE_CUSTOM_CONFIG=y
BR2_LINUX_KERNEL_CUSTOM_CONFIG_FILE="board/shredos/kernel-6.4-defconfig.config"
BR2_PACKAGE_LINUX_TOOLS_CPUPOWER=y
BR2_PACKAGE_LINUX_TOOLS_PERF=y
BR2_PACKAGE_LINUX_TOOLS_SELFTESTS=y
BR2_PACKAGE_FFMPEG=n
BR2_PACKAGE_FFMPEG_GPL=n
BR2_PACKAGE_FFMPEG_NONFREE=n
BR2_PACKAGE_BZIP2=y
BR2_PACKAGE_GZIP=y
BR2_PACKAGE_UNZIP=y
BR2_PACKAGE_XZ=y
BR2_PACKAGE_ZIP=y
BR2_PACKAGE_HEXEDIT=n
BR2_PACKAGE_BINUTILS=y
BR2_PACKAGE_GETTEXT=y
BR2_PACKAGE_GREP=y
BR2_PACKAGE_LIBTOOL=y
BR2_PACKAGE_SED=y
BR2_PACKAGE_DOSFSTOOLS=y
BR2_PACKAGE_DOSFSTOOLS_FATLABEL=y
BR2_PACKAGE_DOSFSTOOLS_FSCK_FAT=y
BR2_PACKAGE_DOSFSTOOLS_MKFS_FAT=y
BR2_PACKAGE_E2FSPROGS=y
BR2_PACKAGE_EXFATPROGS=y
BR2_PACKAGE_ASCII_INVADERS=n
BR2_PACKAGE_DIRECTFB=y
BR2_PACKAGE_DIRECTFB_ATI128=y
BR2_PACKAGE_DIRECTFB_MATROX=y
BR2_PACKAGE_DIRECTFB_I830=y
BR2_PACKAGE_FBDUMP=n
BR2_PACKAGE_FBGRAB=n
BR2_PACKAGE_FBSET=n
BR2_PACKAGE_FBTERM=n
BR2_PACKAGE_FBV=n
BR2_PACKAGE_MESA3D=y
BR2_PACKAGE_MESA3D_LLVM=y
BR2_PACKAGE_MESA3D_GALLIUM_DRIVER_CROCUS=y
BR2_PACKAGE_MESA3D_GALLIUM_DRIVER_ETNAVIV=y
BR2_PACKAGE_MESA3D_GALLIUM_DRIVER_I915=y
BR2_PACKAGE_MESA3D_GALLIUM_DRIVER_IRIS=y
BR2_PACKAGE_MESA3D_GALLIUM_DRIVER_LIMA=y
BR2_PACKAGE_MESA3D_GALLIUM_DRIVER_PANFROST=y
BR2_PACKAGE_MESA3D_GALLIUM_DRIVER_R300=y
BR2_PACKAGE_MESA3D_GALLIUM_DRIVER_R600=y
BR2_PACKAGE_MESA3D_GALLIUM_DRIVER_RADEONSI=y
BR2_PACKAGE_MESA3D_GALLIUM_DRIVER_SVGA=y
BR2_PACKAGE_MESA3D_GALLIUM_DRIVER_TEGRA=y
BR2_PACKAGE_MESA3D_GALLIUM_DRIVER_VIRGL=y
BR2_PACKAGE_MESA3D_VULKAN_DRIVER_INTEL=y
BR2_PACKAGE_MESA3D_OSMESA_GALLIUM=y
BR2_PACKAGE_MESA3D_OPENGL_ES=y
BR2_PACKAGE_LINUX_FIRMWARE=y
BR2_PACKAGE_LINUX_FIRMWARE_AMDGPU=y
BR2_PACKAGE_LINUX_FIRMWARE_I915=y
BR2_PACKAGE_LINUX_FIRMWARE_RADEON=y
BR2_PACKAGE_LINUX_FIRMWARE_QCOM_VENUS=n
BR2_PACKAGE_LINUX_FIRMWARE_QCOM_ADRENO=n
BR2_PACKAGE_LINUX_FIRMWARE_MFC_V8=n
BR2_PACKAGE_LINUX_FIRMWARE_QUALCOMM_6174=n
BR2_PACKAGE_LINUX_FIRMWARE_BROADCOM_TIGON3=n
BR2_PACKAGE_LINUX_FIRMWARE_BNX2X=n
BR2_PACKAGE_LINUX_FIRMWARE_CXGB4_T4=n
BR2_PACKAGE_LINUX_FIRMWARE_CXGB4_T5=n
BR2_PACKAGE_LINUX_FIRMWARE_INTEL_E100=y
BR2_PACKAGE_LINUX_FIRMWARE_INTEL_ICE=y
BR2_PACKAGE_LINUX_FIRMWARE_MICROCHIP_VSC85XX_PHY=y
BR2_PACKAGE_LINUX_FIRMWARE_QLOGIC_4X=y
BR2_PACKAGE_LINUX_FIRMWARE_RTL_815X=y
BR2_PACKAGE_LINUX_FIRMWARE_RTL_8169=y
BR2_PACKAGE_LINUX_FIRMWARE_QLOGIC_2XXX=n
BR2_PACKAGE_EDID_DECODE=y
BR2_PACKAGE_HDPARM=y
BR2_PACKAGE_HWDATA=y
BR2_PACKAGE_KBD=y
BR2_PACKAGE_LM_SENSORS=y
BR2_PACKAGE_MINICOM=y
BR2_PACKAGE_NVME=y
BR2_PACKAGE_READ_EDID=y
BR2_PACKAGE_SG3_UTILS=y
BR2_PACKAGE_SG3_UTILS_PROGS=y
BR2_PACKAGE_SMARTMONTOOLS=y
BR2_PACKAGE_SYSSTAT=y
BR2_PACKAGE_TRIGGERHAPPY=y
BR2_PACKAGE_PYTHON_PYASN1_MODULES=y
BR2_PACKAGE_PYTHON_PYNDIFF=y
BR2_PACKAGE_PYTHON_SCAPY=y
BR2_PACKAGE_LZ4=y
BR2_PACKAGE_LIBGCRYPT=y
BR2_PACKAGE_LIBJPEG=y
BR2_PACKAGE_ZXING_CPP=y
BR2_PACKAGE_LIBHID=y
BR2_PACKAGE_JSON_GLIB=y
BR2_PACKAGE_LIBCURL=y
BR2_PACKAGE_LIBUPNP=y
BR2_PACKAGE_KERNEL_CMDLINE_EXTRACTOR=y
BR2_PACKAGE_LIBCAP=y
BR2_PACKAGE_LIBSECCOMP=y
BR2_PACKAGE_NWIPE=y
BR2_PACKAGE_LIBFRIBIDI=y
BR2_PACKAGE_NCURSES_WCHAR=y
BR2_PACKAGE_UTF8PROC=y
BR2_PACKAGE_HEIRLOOM_MAILX=n
BR2_PACKAGE_COLLECTD=y
BR2_PACKAGE_COLLECTD_NTPD=y
BR2_PACKAGE_XUTIL_UTIL_MACROS=y
BR2_PACKAGE_IPTABLES=y
BR2_PACKAGE_LFTP=y
BR2_PACKAGE_LFTP_PROTO_SFTP=y
BR2_PACKAGE_NMAP=y
BR2_PACKAGE_NTP=y
BR2_PACKAGE_NTP_NTPDATE=y
BR2_PACKAGE_NTP_NTPTIME=y
BR2_PACKAGE_RPCBIND=y
BR2_PACKAGE_SNMPCLITOOLS=y
BR2_PACKAGE_TFTPD=y
BR2_PACKAGE_TRACEROUTE=y
BR2_PACKAGE_WIREGUARD_TOOLS=n
BR2_PACKAGE_RESTORECOND=y
BR2_PACKAGE_SELINUX_PYTHON=y
BR2_PACKAGE_SELINUX_PYTHON_AUDIT2ALLOW=y
BR2_PACKAGE_TMUX=y
BR2_PACKAGE_RUNC=y
BR2_PACKAGE_UTIL_LINUX_BINARIES=y
BR2_PACKAGE_UTIL_LINUX_AGETTY=y
BR2_PACKAGE_UTIL_LINUX_FSCK=y
BR2_PACKAGE_UTIL_LINUX_LAST=y
BR2_PACKAGE_UTIL_LINUX_LOGIN=y
BR2_PACKAGE_UTIL_LINUX_MOUNT=y
BR2_PACKAGE_UTIL_LINUX_MOUNTPOINT=y
BR2_PACKAGE_UTIL_LINUX_PIVOT_ROOT=y
BR2_PACKAGE_UTIL_LINUX_RFKILL=y
BR2_PACKAGE_UTIL_LINUX_RUNUSER=y
BR2_PACKAGE_UTIL_LINUX_SETTERM=y
BR2_PACKAGE_UTIL_LINUX_SU=y
BR2_PACKAGE_UTIL_LINUX_SULOGIN=y
#BR2_TARGET_ROOTFS_CPIO_LZMA=y
BR2_TARGET_ROOTFS_CPIO_ZSTD=y
BR2_TARGET_ROOTFS_EXT2=y
BR2_TARGET_ROOTFS_EXT2_SIZE="350M"
BR2_TARGET_ROOTFS_INITRAMFS=y
BR2_TARGET_ROOTFS_EXT2_ZSTD=y
BR2_TARGET_ROOTFS_TAR=y
BR2_TARGET_ROOTFS_TAR_ZSTD=y
BR2_TARGET_GRUB2=y
BR2_TARGET_GRUB2_I386_PC=y
BR2_TARGET_GRUB2_X86_64_EFI=y
BR2_TARGET_GRUB2_BUILTIN_MODULES_PC="boot linux ext2 fat squash4 part_msdos part_gpt normal progress biosdisk all_video video_cirrus video_bochs net tftp gzio test eval read true gfxterm gfxterm_menu gfxmenu gfxterm_background png usb usb_keyboard"
BR2_TARGET_GRUB2_BUILTIN_MODULES_EFI="boot linux ext2 fat squash4 part_msdos part_gpt normal progress efi_gop efi_uga all_video video_cirrus video_bochs net efinet tftp gzio test eval read true gfxterm gfxterm_menu gfxmenu gfxterm_background png usb usb_keyboard"
BR2_TARGET_GRUB2_INSTALL_TOOLS=y
BR2_PACKAGE_HOST_GENIMAGE=y
BR2_PACKAGE_HOST_PYTHON3=y
BR2_PACKAGE_HOST_PYTHON3_BZIP2=y
BR2_PACKAGE_HOST_PYTHON3_SSL=y
# CTA PACKAGES
BR2_PACKAGE_JQ=y
BR2_PACKAGE_LSHW=y
BR2_PACKAGE_DIALOG=y
BR2_CCACHE=y
BR2_PACKAGE_TPM2_TSS=y
BR2_PACKAGE_ZSTD=y
```
